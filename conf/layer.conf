## conf/layer.conf
```bitbake
# We have a conf and classes directory, add to BBPATH
BBPATH .= ":${LAYERDIR}"

# We have recipes-* directories, add to BBFILES
BBFILES += "${LAYERDIR}/recipes-*/*/*.bb \
            ${LAYERDIR}/recipes-*/*/*.bbappend"

BBFILE_COLLECTIONS += "meta-qemuarma9"
BBFILE_PATTERN_meta-qemuarma9 = "^${LAYERDIR}/"
BBFILE_PRIORITY_meta-qemuarma9 = "6"

LAYERDEPENDS_meta-qemuarma9 = "core"
LAYERSERIES_COMPAT_meta-qemuarma9 = "kirkstone"
```
